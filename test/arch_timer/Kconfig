## test/blkdev/Kconfig
```kconfig
config TEST_BLKDEV
	bool "Block Device Test"
	help
	Block device test case, iterate all block devices, this case just show data in given offset.
	Customer should check it by hand.
```

## test/bootdev/Kconfig
```kconfig
config TEST_BOOTDEV
	bool "Boot Device"
	select DRIVER_BOOTDEV
	help
	Boot device testcase
```

## test/c2clat/Kconfig
```kconfig
config TEST_C2CLAT
	bool "Core-to-Core Latency Test"
	help
	Core-to-Core Latency testcase
```

## test/fab/Kconfig
```kconfig
config TEST_FAB
	bool "FAB"
	help
	fabric accessibility and baudwidth for key memory region
```

## test/hello/Kconfig
```kconfig
config TEST_HELLO
	bool "HelloWorld"
	help
	sample testcase, you can use this as a testcase template
```

## test/riscv_exception/Kconfig
```kconfig
config TEST_RISCV_EXCEPTION
	bool "RISCV Exception"
	help
	  qemu machine virt test riscv exception
```

## test/spi-flash/Kconfig
```kconfig
config TEST_SPI_FLASH
	bool "SPI Flash"
	help
	use to test the function of spiflash
```
