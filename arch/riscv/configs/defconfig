## arch/riscv/configs/defconfig
```kconfig
CONFIG_RAM_START=0x80000000
CONFIG_RAM_SIZE=0x01000000
CONFIG_PLAT_QEMU_RISCV_VIRT=y
CONFIG_ARCH_SET_TIMER_FREQ=y
CONFIG_ARCH_TIMER_FREQ=10000000
CONFIG_SUPPORT_SMP=y
CONFIG_SMP_NUM=128
CONFIG_SUPPORT_BUILTIN_DTB=y
CONFIG_BUILTIN_DTB="qemu-virt.dtb"
CONFIG_TARGET_ASIC=y
CONFIG_CC_OPTIMIZE_NONE=y
CONFIG_MULTI_THREAD=y
CONFIG_VFS=y
CONFIG_DRIVER_SERIAL_NS16550=y
CONFIG_DRIVER_PLATFORM=y
CONFIG_DRIVER_BLOCK_DEVICE=y
CONFIG_DRIVER_BLOCK_DEVICE_VIRTIO=y
CONFIG_DRIVER_MTD=y
CONFIG_DRIVER_MTD_CFI_FLASH=y
CONFIG_DRIVER_BLOCK_DEVICE_MTDBLOCK=y
CONFIG_FS_FATFS=y
CONFIG_FS_SGPART=y
CONFIG_FS_FLASHMOUNT=y
CONFIG_FS_AUTOMOUNT=y
CONFIG_TEST=y
CONFIG_TEST_MULTI_THREAD_STRESS=y
CONFIG_TEST_VFS=y
CONFIG_TEST_MTDBLOCK=y
CONFIG_TEST_SGPART=y
```

## drivers/blkdev/Kconfig
```kconfig
menuconfig DRIVER_BLOCK_DEVICE
	bool "Support Block Device Model"
	select DRIVER_DEVICE_MODEL
	default	n
	help
		Support block device driver model.

if DRIVER_BLOCK_DEVICE

config DRIVER_BLOCK_DEVICE_SDHCI_DWC
	bool "Designware SDHCI"
	default n
	help
		Designware SDHCI device driver.

config DRIVER_BLOCK_DEVICE_VIRTIO
	bool "virtio-blk (virtio-mmio)"
	default n
	help
		virtio-blk block device over virtio-mmio (e.g. QEMU virt).

config DRIVER_BLOCK_DEVICE_MTDBLOCK
	bool "mtdblock (MTD as block device)"
	depends on DRIVER_MTD
	default n
	help
		Expose each registered MTD device as a block device. Reads pass
		straight through to the MTD (no sector alignment); writes are not
		supported. Enumerated automatically at init.
endif
```

## drivers/mtd/Kconfig
```kconfig
menuconfig DRIVER_MTD
	bool "Support Memory Technology Device Model"
	select DRIVER_DEVICE_MODEL
	default	n
	help
		Support memory technology device driver model.

if DRIVER_MTD

config DRIVER_MTD_SOPHGO_SPIFMC
	bool "SOPHGO SPI NOR Flash Memory Controller"
	default n
	help
		SOPHGO SPI NOR Flash Memory Controller.

config DRIVER_MTD_CFI_FLASH
	bool "CFI NOR flash (memory-mapped, read-only)"
	default n
	help
		Read-only driver for memory-mapped CFI parallel NOR flash, such
		as the pflash exposed by the QEMU RISC-V virt machine (the
		"cfi-flash" node). Registers the flash window as an MTD device.

endif
```

## fs/Kconfig
```kconfig
menu "File systems"

config FS_SYSFS
	bool "sysfs (device tree under /sys)"
	depends on VFS
	default y
	help
	  Present the unified device registry as empty directories under
	  /sys/devices/<device-name>.

config FS_FATFS
	bool "fatfs (FAT filesystem via VFS)"
	depends on VFS && DRIVER_BLOCK_DEVICE
	default n
	help
	  Mount FAT volumes on block devices into the VFS at /fatN, backed by
	  the FatFs library. Read-only; files are resolved on demand.

config FS_SGPART
	bool "sgpart (sophgo partition table via VFS)"
	depends on VFS && DRIVER_BLOCK_DEVICE
	default n
	help
	  Expose a sophgo flat partition table as a filesystem: each partition
	  becomes a regular file under the mount point. Not self-describing;
	  mounted explicitly with a {blkdev, offset} via struct sgpart_data.
	  Read-only.

config FS_FLASHMOUNT
	bool "Flash sophgo-boot mounter"
	depends on FS_SGPART && DRIVER_BLOCK_DEVICE_MTDBLOCK
	default n
	help
	  Mount policy for the flash path: for each MTD carrying a "sophgo-boot"
	  DTB property, read the partition-table offset, wrap the MTD as a block
	  device, and mount sgpart at /mnt/flash. The one place that reads the
	  DTB for the flash path.

config FS_AUTOMOUNT
	bool "Automount block devices"
	depends on VFS && DRIVER_BLOCK_DEVICE
	default n
	help
	  Enumerate block devices and mount each at /blkN, auto-detecting the
	  filesystem among the registered ones. Devices with no recognized
	  filesystem are skipped.

endmenu
```

## plat/Kconfig
```kconfig
menu "Platform"

choice
	prompt "Platform"

config PLAT_QEMU_RISCV_VIRT
	depends on ARCH_RISCV
	bool "QEMU RISCV Virt Machine"

config PLAT_SG2042
	bool "SG2042"

config PLAT_SG2044
	bool "SG2044"
	select RISCV_CMO

config PLAT_BM1690
	bool "BM1690 TPU SCALAR"
	select RISCV_CMO

endchoice

config PLAT
	string
	default "QEMU-RISCV-Virt" if PLAT_QEMU_RISCV_VIRT
	default "SG2042" if PLAT_SG2042
	default "SG2044" if PLAT_SG2044
	default "BM1690" if PLAT_BM1690
	default "unknown-platform"

if PLAT_QEMU_RISCV_VIRT
source "plat/qemu-riscv-virt/Kconfig"
endif

if PLAT_SG2042
source "plat/sg2042/Kconfig"
endif

if PLAT_BM1690
source "plat/bm1690/Kconfig"
endif

if PLAT_SG2044
source "plat/sg2044/Kconfig"
endif

choice
	prompt "Target"

config TARGET_EMULATOR
	bool "EDA Emulator"
	help
	ic design EDA emulation

config TARGET_PALLADIUM
	bool "Cadence Palladium"
	help
	cadence palladium emulation

config TARGET_FPGA
	bool "FPGA"
	help
	FPGA emulation

config TARGET_ASIC
	bool "ASIC"
	help
	real chip

endchoice

config TARGET
	string
	default "ASIC" if TARGET_ASIC
	default "FPGA" if TARGET_FPGA
	default "PALLADIUM" if TARGET_PALLADIUM
	default "EMULATOR" if TARGET_EMULATOR

endmenu
```

## plat/bm1690/tp/Kconfig
```kconfig
choice
	prompt "Application"

config BM1690_TP_ZSBL
	bool "ZSBL"
	select BM1690_TP
	help
	1st boot on main processor

endchoice
```

## plat/qemu-riscv-virt/mp/Kconfig
```kconfig
choice
	prompt "Application"

config QEMU_RISCV_VIRT_MP_ZSBL
	bool "ZSBL"
	select QEMU_RISCV_VIRT_MP
	help
	1st boot on main processor

endchoice
```

## plat/sg2042/mp/Kconfig
```kconfig
choice
	prompt "Application"

config SG2042_MP_ZSBL
	bool "ZSBL"
	select SG2042_MP
	help
	1st boot on main processor

endchoice
```

## plat/sg2044/mp/Kconfig
```kconfig
choice
	prompt "Application"

config SG2044_MP_ZSBL
	bool "ZSBL"
	select SG2044_MP
	help
	1st boot on main processor

endchoice
```

## test/mtdblock/Kconfig
```kconfig
config TEST_MTDBLOCK
	bool "mtdblock pass-through test"
	depends on DRIVER_BLOCK_DEVICE_MTDBLOCK
	help
	Verify that reading through an mtdblock blkdev returns exactly what
	reading the underlying MTD returns, at both aligned and unaligned
	offsets, and that writes are rejected.
```

## test/sgpart/Kconfig
```kconfig
config TEST_SGPART
	bool "sgpart filesystem test"
	depends on FS_SGPART
	help
	Mount sgpart on a mock block device backed by an in-RAM sophgo
	partition table and verify partitions surface as files, reads are
	windowed to each partition, and a table with no magic is rejected.
```

## test/thread/Kconfig
```kconfig
config TEST_MULTI_THREAD
	bool "Multi Thread"
	depends on MULTI_THREAD
	help
	Test multi thread

config TEST_MULTI_THREAD_STRESS
	bool "Multi Thread Stress Test"
	depends on MULTI_THREAD
	help
	Comprehensive stress test for multi-threading:
	- Thread lifecycle, priority scheduling, semaphore
	- Spinlock contention, atomic operations, sleep/wakeup
	- Preempt disable/enable, stack isolation, many threads
	- Thread exit cleanup, long-running stability, fairness
```
