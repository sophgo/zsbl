## Kconfig
```kconfig
mainmenu "SOPHGO Zero Stage Boot Loader"

source "arch/Kconfig"
source "plat/Kconfig"
source "common/Kconfig"
source "drivers/Kconfig"
source "test/Kconfig"
```

## arch/arm64/configs/bm1686_cp_defconfig
```kconfig
CONFIG_RAM_START=0x10000000
CONFIG_RAM_SIZE=0x00080000
CONFIG_ROM_BOOT=y
CONFIG_ROM_START=0x06400000
CONFIG_ROM_SIZE=0x00c00000
CONFIG_ARCH_SET_TIMER_FREQ=y
CONFIG_ARCH_TIMER_FREQ=50000000
CONFIG_PLAT_BM1686=y
CONFIG_TARGET_ASIC=y
CONFIG_DRIVER_SERIAL_NS16550=y
CONFIG_DRIVER_IRQCHIP_ICTL=y
CONFIG_DRIVER_EFUSE=y
CONFIG_TEST=y
CONFIG_TEST_HELLO=y
CONFIG_LIBS="../build/firmware_core/libfirmware_core.a"
```

## arch/arm64/configs/bm1686_emulator_defconfig
```kconfig
CONFIG_RAM_START=0x100000000
CONFIG_RAM_SIZE=0x01000000
CONFIG_ARCH_SET_TIMER_FREQ=y
CONFIG_ARCH_TIMER_FREQ=50000000

CONFIG_PLAT_BM1686=y
CONFIG_TARGET_EMULATOR=y

CONFIG_CC_OPTIMIZE_FOR_PERFORMANCE=y

CONFIG_LIBS="../build/firmware_core/libfirmware_core.a"
```

## arch/arm64/configs/bm1686_fab_defconfig
```kconfig
CONFIG_RAM_START=0x100000000
CONFIG_RAM_SIZE=0x01000000
CONFIG_ARCH_SET_TIMER_FREQ=y
CONFIG_ARCH_TIMER_FREQ=50000000
CONFIG_PLAT_BM1686=y
CONFIG_PLAT_BM1686_FORCE_WORK_MODE_SOC=y
CONFIG_TARGET_ASIC=y
CONFIG_DRIVER_SERIAL_NS16550=y
CONFIG_DRIVER_IRQCHIP_ICTL=y
CONFIG_TEST=y
CONFIG_TEST_FAB=y
```

## arch/arm64/configs/bm1686_palladium_defconfig
```kconfig
CONFIG_RAM_START=0x100000000
CONFIG_RAM_SIZE=0x01000000
CONFIG_ARCH_SET_TIMER_FREQ=y
CONFIG_ARCH_TIMER_FREQ=50000000

CONFIG_PLAT_BM1686=y
CONFIG_TARGET_PALLADIUM=y

CONFIG_CC_OPTIMIZE_FOR_PERFORMANCE=y
CONFIG_DRIVER_SERIAL_NS16550=y
CONFIG_DRIVER_IRQCHIP_ICTL=y
CONFIG_DRIVER_EFUSE=y

CONFIG_MMIO=y

CONFIG_LIBS="../build/firmware_core/libfirmware_core.a"
```

## arch/arm64/configs/defconfig
```kconfig
CONFIG_RAM_START=0x40000000
CONFIG_RAM_SIZE=0x01000000

CONFIG_PLAT_QEMU=y
CONFIG_TARGET_ASIC=y

CONFIG_CC_OPTIMIZE_FOR_PERFORMANCE=y

CONFIG_DRIVER_SERIAL_PL01=y
CONFIG_DRIVER_IRQCHIP_GIC=y

CONFIG_TEST=y
CONFIG_TEST_HELLO=y
```

## arch/riscv/Kconfig
```kconfig
config ARCH_RISCV
	bool
	default y

menu "RISC-V Options"

config RAM_START
	hex "RAM Start"
	help
		RAM where this program run on

config RAM_SIZE
	hex "RAM Size"
	help
		RAM size that this program never exceed

config ROM_BOOT
	bool "Boot from ROM"
	default n
	help
		Boot from rom. eg on chip bootrom or external spi flash

if ROM_BOOT

config ROM_START
	hex "ROM Start"
	help
		ROM where this program load

config ROM_SIZE
	hex "ROM Size"
	help
		ROM size that this program never exceed

endif

config ARCH_SET_TIMER_FREQ
	bool "Setup Arch Timer Frequency"
	help
		set arch timer frequency instead of using the default one.

if ARCH_SET_TIMER_FREQ
config ARCH_TIMER_FREQ
	int "Arch Timer Frequency"
	help
		risc-v mtime timer frequency, it is usually 50MHz.
endif

config SUPPORT_SMP
	bool "Whether Support Multiple Core"
	default n

if SUPPORT_SMP
config SMP_NUM
	int "SMP Number"
	help
		the cpu numbers
endif

config SUPPORT_BUILTIN_DTB
	bool "Support Builtin DTB"
	help
		Support builtin DTB

if SUPPORT_BUILTIN_DTB

config BUILTIN_DTB
	string "Builtin DTB"
	help
		File name of builtin DTB, DTBs find in arch/riscv/boot/dtb. Replace FOO.dts with FOO.dtb

endif

config RISCV_CMO
	bool "RISC-V CMO"
	default n
	help
		Support RISC-V stdandard cache maintance operations. If not set, platform may need implement
		cache maintance operations of itself.

endmenu
```

## arch/riscv/configs/bm1690_pld_defconfig
```kconfig
CONFIG_RAM_START=0x100000000
CONFIG_RAM_SIZE=0x200000
CONFIG_ARCH_SET_TIMER_FREQ=y
CONFIG_ARCH_TIMER_FREQ=50000000

CONFIG_TARGET_PALLADIUM=y
CONFIG_PLAT_SG2044=y

# for 0: open; for 1-7 closed
# CONFIG_DRIVER_SERIAL_NS16550=y

CONFIG_TEST=y

CONFIG_TPU_SCALAR=y
CONFIG_SUPPORT_SMP=y
CONFIG_SMP_NUM=1

CONFIG_DRIVER_IO=y
CONFIG_DRIVER_SD=y
CONFIG_DRIVER_IRQCHIP=y
CONFIG_DRIVER_EFUSE=y
CONFIG_DRIVER_SPI_FLASH=y

CONFIG_CC_OPTIMIZE_NONE=y
```

## arch/riscv/configs/bm1690_tpu_defconfig
```kconfig
CONFIG_RAM_START=0xd0000000
CONFIG_RAM_SIZE=0x200000
CONFIG_ARCH_SET_TIMER_FREQ=y
CONFIG_ARCH_TIMER_FREQ=50000000

CONFIG_TARGET_ASIC=y
CONFIG_PLAT_SG2044=y

CONFIG_DRIVER_SERIAL_NS16550=y

CONFIG_TEST=y

CONFIG_TPU_SCALAR=y
CONFIG_TPU_SCALAR_START=0xa0000000
CONFIG_TPU_SCALAR_MEM_OFFSET=0x20000000
CONFIG_SUPPORT_SMP=y
CONFIG_SMP_NUM=1

CONFIG_DRIVER_IO=y
CONFIG_DRIVER_SD=y
CONFIG_DRIVER_IRQCHIP=y
CONFIG_DRIVER_EFUSE=y
CONFIG_DRIVER_SPI_FLASH=y

CONFIG_CC_OPTIMIZE_NONE=y
```

## arch/riscv/configs/bm1690tp_defconfig
```kconfig
CONFIG_RAM_START=0x0
CONFIG_RAM_SIZE=0x200000
CONFIG_ARCH_SET_TIMER_FREQ=y
CONFIG_ARCH_TIMER_FREQ=50000000
CONFIG_SUPPORT_SMP=y
CONFIG_SMP_NUM=64
CONFIG_PLAT_BM1690TP=y
CONFIG_TARGET_ASIC=y
```

## arch/riscv/configs/qemu_defconfig
```kconfig
CONFIG_RAM_START=0x80000000
CONFIG_RAM_SIZE=0x01000000
CONFIG_ARCH_SET_TIMER_FREQ=y
CONFIG_ARCH_TIMER_FREQ=10000000
CONFIG_TARGET_ASIC=y
CONFIG_CC_OPTIMIZE_NONE=y
CONFIG_DRIVER_SERIAL_NS16550=y

CONFIG_SUPPORT_SMP=y
CONFIG_SMP_NUM=8

CONFIG_DRIVER_IO=y
CONFIG_DRIVER_IRQCHIP=y

CONFIG_TEST=y
#CONFIG_TEST_SMP=y
CONFIG_TEST_RISCV_EXCEPTION=y
```

## arch/riscv/configs/sg2042_defconfig
```kconfig
CONFIG_RAM_START=0x40000000
CONFIG_RAM_SIZE=0x200000
CONFIG_ARCH_SET_TIMER_FREQ=y
CONFIG_ARCH_TIMER_FREQ=50000000
CONFIG_SUPPORT_SMP=y
CONFIG_SMP_NUM=128
CONFIG_SUPPORT_BUILTIN_DTB=y
CONFIG_BUILTIN_DTB="sg2042.dtb"
CONFIG_PLAT_SG2042=y
CONFIG_TARGET_ASIC=y
CONFIG_DRIVER_SERIAL_NS16550=y
CONFIG_DRIVER_EFUSE=y
CONFIG_DRIVER_SPI_FLASH=y
CONFIG_DRIVER_PLATFORM=y
CONFIG_DRIVER_BLOCK_DEVICE=y
CONFIG_DRIVER_BLOCK_DEVICE_SDHCI_DWC=y
CONFIG_DRIVER_MTD=y
CONFIG_DRIVER_BOOT_DEVICE=y
```

## arch/riscv/configs/sg2044_defconfig
```kconfig
CONFIG_RAM_START=0x90000000
CONFIG_RAM_SIZE=0x200000
CONFIG_ARCH_SET_TIMER_FREQ=y
CONFIG_ARCH_TIMER_FREQ=50000000
CONFIG_SUPPORT_SMP=y
CONFIG_SMP_NUM=64
CONFIG_SUPPORT_BUILTIN_DTB=y
CONFIG_BUILTIN_DTB="sg2044.dtb"
CONFIG_PLAT_SG2044=y
CONFIG_TARGET_ASIC=y
CONFIG_DRIVER_SERIAL_NS16550=y
CONFIG_DRIVER_PLATFORM=y
CONFIG_DRIVER_BLOCK_DEVICE=y
CONFIG_DRIVER_BLOCK_DEVICE_SDHCI_DWC=y
CONFIG_DRIVER_MTD=y
CONFIG_DRIVER_BOOT_DEVICE=y
CONFIG_SOPHGO_FAT_BOOT_DEVICE_FRAMEWORK=y
CONFIG_SOPHGO_CONFIG_BOOT_DEVICE_FRAMEWORK=y
CONFIG_SOPHGO_MTD_BOOT_DEVICE_FRAMEWORK=y
```

## arch/riscv/configs/sg2260_defconfig
```kconfig
CONFIG_RAM_START=0x0
CONFIG_RAM_SIZE=0x2000000
CONFIG_ARCH_SET_TIMER_FREQ=y
CONFIG_ARCH_TIMER_FREQ=50000000
CONFIG_SUPPORT_SMP=y
CONFIG_SMP_NUM=64
CONFIG_PLAT_SG2044=y
CONFIG_TARGET_ASIC=y
CONFIG_CC_OPTIMIZE_NONE=y
CONFIG_DRIVER_SERIAL_NS16550=y
CONFIG_DRIVER_EFUSE=y
CONFIG_DRIVER_SD=y
CONFIG_DRIVER_SPI_FLASH=y
CONFIG_DRIVER_IO=y
CONFIG_TEST=y
```

## arch/riscv/configs/sg2380_defconfig
```kconfig
CONFIG_RAM_START=0x50b5140000
CONFIG_RAM_SIZE=0x40000
CONFIG_ARCH_SET_TIMER_FREQ=y
CONFIG_ARCH_TIMER_FREQ=50000000

CONFIG_TARGET_PALLADIUM=y
CONFIG_PLAT_SG2380=y

CONFIG_DRIVER_SERIAL_NS16550=y

CONFIG_TEST=y

CONFIG_SUPPORT_SMP=y
CONFIG_SMP_NUM=16

CONFIG_DRIVER_IO=y
CONFIG_DRIVER_SD=y
CONFIG_DRIVER_EFUSE=y
CONFIG_DRIVER_SPI_FLASH=y
CONFIG_DRIVER_PCIE=y
CONFIG_DRIVER_WDT=y
CONFIG_DRIVER_DDR=y
CONFIG_DRIVER_PCIE=y

CONFIG_CC_OPTIMIZE_FOR_SIZE=y
```

## arch/riscv/configs/sg2380_x280_defconfig
```kconfig
CONFIG_RAM_START=0xa0000000
CONFIG_RAM_SIZE=0x40000
CONFIG_STACK_SIZE=0x1000
CONFIG_ARCH_SET_TIMER_FREQ=y
CONFIG_ARCH_TIMER_FREQ=50000000

CONFIG_TARGET_PALLADIUM=y
CONFIG_PLAT_X280=y

CONFIG_SUPPORT_SMP=y
CONFIG_SMP_NUM=4

CONFIG_DRIVER_SERIAL_NS16550=y

CONFIG_TEST=y

CONFIG_CC_OPTIMIZE_FOR_SIZE=y
```

## common/Kconfig
```kconfig
menu "Common Features"

config DEBUG
	bool "Enable Debug"
	default n
	help
	Generate executable file for debug

config DEBUG_INFO
	bool "Compile With Debug Info"
	default y
	help
	choosing this option will pass "-g" to your compiler, debug information
	should be added into final elf file.

config LOCALVERSION
	string "Local version - append to ZSBL release"
	help
	  Append an extra string to the end of your ZSBL version.
	  This will show up in your boot log, for example.
	  The string you set here will be appended after the contents of
	  any files with a filename matching localversion* in your
	  object and source tree, in that order.  Your total string can
	  be a maximum of 64 characters.

config LOCALVERSION_AUTO
	bool "Automatically append version information to the version string"
	default y
	help
	  This will try to automatically determine if the current tree is a
	  release tree by looking for Git tags that belong to the current
	  top of tree revision.

	  A string of the format -gxxxxxxxx will be added to the localversion
	  if a Git-based tree is found.  The string generated by this will be
	  appended after any matching localversion* files, and after the value
	  set in CONFIG_LOCALVERSION.

	  (The actual string used here is the first eight characters produced
	  by running the command:

	    $ git rev-parse --verify HEAD

	  which is done within the script "scripts/setlocalversion".)

choice
	prompt "Compiler Optimization Level"
	default CC_OPTIMIZE_FOR_PERFORMANCE

config CC_OPTIMIZE_NONE
	bool "Optimize Nothing (-O0)"
	help
	choosing this option will pass "-O0" to your compiler. compiler should
	not optimize your program. this is for debug purpose. eg. using gdb
	
config CC_OPTIMIZE_FOR_PERFORMANCE
	bool "Optimize for Performance (-O2)"
	help
	this is the default optimization level, building
	with the "-O2" compiler flag for best performance and most
	helpful compile-time warnings.

config CC_OPTIMIZE_FOR_PERFORMANCE_O3
	bool "Optimize More for Performance (-O3)"
	help
	choosing this option will pass "-O3" to your compiler,
	yet more for performance.

config CC_OPTIMIZE_FOR_SIZE
	bool "Optimize for Size (-Os)"
	help
	choosing this option will pass "-Os" to your compiler resulting
	in a smaller executable file.

endchoice

config LIBS
	string "External Library File"
	help
	external library, seperated by space. put static library full name here.
	eg. foo/bar/libsome-lib.a

config MMIO
	bool "IO Safty Memory Operations"
	default n
	help
	normally memset, memcpy and memmove assume memory regions are normal
	memory, unaligned access is allowed. but for ram that mapped as device
	memory by mmu, unaligned access is not allowed. memory access to those
	regions are strictly aligned to natural boundary. enable this, if you
	want access such regions using normal memset, memcpy or memmove. it
	may speedup operations in most conditions.

config MULTI_THREAD
	bool "Multi Thread"
	default n
	help
	support multi thread.

endmenu
```

## drivers/Kconfig
```kconfig
menu "Device Drivers"

source "drivers/serial/Kconfig"
source "drivers/irqchip/Kconfig"
source "drivers/efuse/Kconfig"
source "drivers/sd/Kconfig"
source "drivers/spi-flash/Kconfig"
source "drivers/io/Kconfig"

source "drivers/base/Kconfig"
source "drivers/platform/Kconfig"

endmenu
```

## drivers/accdev/Kconfig
```kconfig
config DRIVER_ACCELERATOR
	bool "Support Accelerator Device"
	select DRIVER_DEVICE_MODEL
	default	n
	help
		Support Accelerator Device.

if DRIVER_ACCELERATOR

config DRIVER_PKA
	bool "Support PKA"
	default	n
	help
		Support PKA.
```

## drivers/alg/Kconfig
```kconfig
menuconfig DRIVER_ALG_DEVICE
	bool "Support Signature Verification Algorithms"
	default	n
	help
		Support Signature Verification Algorithms.

if DRIVER_ALG_DEVICE

config DRIVER_ALG_DEVICE_PKA
	bool "Support PKA Driver"
	default n
	help
		Support PKA Driver
endif
```

## drivers/boot/Kconfig
```kconfig
config DRIVER_BOOT_DEVICE
	bool "Support Boot Device Driver Model"
	select DRIVER_DEVICE_MODEL
	default	n
	help
		Support boot device driver model.
```
