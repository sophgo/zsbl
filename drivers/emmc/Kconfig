## drivers/irqchip/Kconfig
```kconfig
config DRIVER_INTERRUPT
	bool "Support Interrupt"
	default n
	help
	Support interrupt.

if DRIVER_INTERRUPT
source "drivers/irqchip/ictl/Kconfig"
source "drivers/irqchip/intc/Kconfig"
source "drivers/irqchip/plic/Kconfig"
source "drivers/irqchip/mtli/Kconfig"
endif
```

## drivers/irqchip/intc/Kconfig
```kconfig
config DRIVER_IRQCHIP_INTC
	bool "BM1686 Interrupt Controller"
	help
	based on designware ictl, it chains two ictl togather.
```

## drivers/irqchip/mtli/Kconfig
```kconfig
config DRIVER_IRQCHIP_MTLI
	bool "SOPHGO MTLI"
	help
	Enable support of SOPHGO MTLI
```

## drivers/irqchip/plic/Kconfig
```kconfig
config DRIVER_IRQCHIP_PLIC
	bool "RISC-V PLIC"
	help
	Enable support of RISC-V PLIC interrupt controller.
```

## drivers/nvmem/Kconfig
```kconfig
menuconfig DRIVER_NVMEM_DEVICE
	bool "Support NVMEM Device Model"
	select DRIVER_DEVICE_MODEL
	default	n
	help
		Support nvmem(None Volatile Memory) device driver model.
		Like efuse, eeprom, etc.

if DRIVER_NVMEM_DEVICE

config DRIVER_NVMEM_DEVICE_SG_EFUSE
	bool "Sophgo eFuse"
	default n
	help
		SOPHGO eFuse controller
endif
```

## drivers/platform/Kconfig
```kconfig
config DRIVER_PLATFORM
	bool "Support Platform Device Model"
	depends on SUPPORT_BUILTIN_DTB
	select DRIVER_DEVICE_MODEL
	default	n
	help
		Support platform device driver model.
		Support device probe by builtin device tree
		Customer should set builtin device tree proper
```

## drivers/serial/Kconfig
```kconfig
menuconfig DRIVER_SERIAL_DEVICE
	bool "Serial Ports"
	select DRIVER_DEVICE_MODEL
	default	y
	help
		Support serial device driver model.

if DRIVER_SERIAL_DEVICE

source "drivers/serial/pl01/Kconfig"
source "drivers/serial/ns16550/Kconfig"

endif
```

## drivers/serial/ns16550/Kconfig
```kconfig
config DRIVER_SERIAL_NS16550
	bool	"NS16550 Serial Port Support"
	help
	ns16550 compatible serial port driver

if DRIVER_SERIAL_NS16550

config DRIVER_SERIAL_NS16550_EARLY_SERIAL
	bool	"NS16550 Early Serial Port Support"
	help
		ns16550 compatible serial port driver

if DRIVER_SERIAL_NS16550_EARLY_SERIAL

config DRIVER_SERIAL_NS16550_EARLY_SERIAL_BASE
	hex	"NS16550 Early Serial Port Base Address"
	help
		Base address of ns16550 early serial port

config DRIVER_SERIAL_NS16550_EARLY_SERIAL_REG_IO_WIDTH
	int	"NS16550 Early Serial Port Register IO Width"
	default	4
	help
		Register IO width of ns16550 early serial port

config DRIVER_SERIAL_NS16550_EARLY_SERIAL_REG_SHIFT
	int	"NS16550 Early Serial Port Register Shift"
	default	2
	help
		Register shift of ns16550 early serial port

config DRIVER_SERIAL_NS16550_EARLY_SERIAL_BAUDRATE
	int	"NS16550 Early Serial Port Baudrate"
	default	115200
	help
		Baudrate of ns16550 early serial port

config DRIVER_SERIAL_NS16550_EARLY_SERIAL_CLOCK
	int	"NS16550 Early Serial Port Input Clock"
	default	500000000
	help
		Input clock of ns16550 early serial port

endif

endif
```

## drivers/serial/pl01/Kconfig
```kconfig
config DRIVER_SERIAL_PL01
	bool	"PL01x Serial Port Support"
	help
		pl01x serial port support
```

## drivers/spi-flash/Kconfig
```kconfig
config DRIVER_SPI_FLASH
	bool "spi flash driver"
	help
	bitmain SPI_FLASH controller driver
```

## drivers/spinand/Kconfig
```kconfig
config DRIVER_SPI_NAND
	bool "DRIVER_SPI_NAND"
	help
	SPI_FLASH controller driver
```

## lib/Kconfig
```kconfig
menu "Libraries"

source "lib/sgfat/Kconfig"
source "lib/sgcfg/Kconfig"
source "lib/sgmtd/Kconfig"

endmenu
```

## lib/alg/Kconfig
```kconfig
config ALG_VERIFY
	bool "Support Signature Verification Algorithms"
	select DRIVER_ACCELERATOR
	default	n
	help
		Support Accelerator Device.

if ALG_VERIFY

config ALG_HASH
	bool "Support Hash"
	default	n
	help
		Support Hash.

config ALG_RSA_SHA256
	bool "Support RSA(SHA256)"
	default	n
	help
		Support RSA(SHA256).

config ALG_SM2_SM3
	bool "Support SM2(SM3)"
	default	n
	help
		Support SM2(SM3).
```

## lib/sgcfg/Kconfig
```kconfig
config SOPHGO_CONFIG_BOOT_DEVICE_FRAMEWORK
	bool "Support SOPHGO Config Boot Device Framework"
	select DRIVER_DEVICE_MODEL
	depends on DRIVER_MTD
	default	n
	help
		Support SOPHGO config boot device framework. We may store conf.ini file into
		a seperate flash. This config file contain information apply to a board or
		a specific chip. It stores from the begining of the flash.
```

## lib/sgfat/Kconfig
```kconfig
config SOPHGO_FAT_BOOT_DEVICE_FRAMEWORK
	bool "Support SOPHGO FAT32 Boot Device Framework"
	select DRIVER_DEVICE_MODEL
	depends on DRIVER_BLOCK_DEVICE
	default	n
	help
		Support SOPHGO FAT32 Boot Device Framework. Requirements:
		1. Block device with a partition table
		2. Partition table should be in MBR format, GPT is not support yet
		3. The first partition should be FAT32 format.
		This framework trys to find all block devices(iterate block device list), bind an FAT32
		file system on it. When load function called, it always loads files from the first
		partition of this block device.
```

## lib/sgmtd/Kconfig
```kconfig
config SOPHGO_MTD_BOOT_DEVICE_FRAMEWORK
	bool "Support SOPHGO MTD Boot Device Framework"
	select DRIVER_DEVICE_MODEL
	depends on DRIVER_MTD
	default	n
	help
		SOPHGO SPI flash(including SPI NOR flash or SPI NAND flash) boot device framework.
		It iterates all MTD devices who have sophgo-boot property in its device blob node.
```

## plat/bm1686/Kconfig
```kconfig
choice
	prompt "Work Mode"
	default PLAT_BM1686_FORCE_WORK_MODE_AUTO

config PLAT_BM1686_FORCE_WORK_MODE_SOC
	bool "SoC"
	help
	Force BM1686 working at SoC mode

config PLAT_BM1686_FORCE_WORK_MODE_PCIE
	bool "PCIe"
	help
	Force BM1686 working at PCIe mode

config PLAT_BM1686_FORCE_WORK_MODE_AUTO
	bool "Auto"
	help
	Select a suitable working mode

endchoice
```

## test/Kconfig
```kconfig
menuconfig TEST
	bool "Test Mode"
	help
	enter test mode instead of real firmware function

if TEST
source "test/arch_timer/Kconfig"
source "test/gic/Kconfig"
source "test/fab/Kconfig"
source "test/hello/Kconfig"
source "test/smp/Kconfig"
source "test/sd/Kconfig"
source "test/fat32/Kconfig"
source "test/spi-flash/Kconfig"
source "test/riscv_exception/Kconfig"
source "test/blkdev/Kconfig"
source "test/bootdev/Kconfig"
endif
```
